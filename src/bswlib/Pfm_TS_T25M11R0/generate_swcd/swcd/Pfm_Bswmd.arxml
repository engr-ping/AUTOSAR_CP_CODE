AUTOSAR XML (schema 4-0-3)
package /BswModule_Pfm
  bsw module description Pfm: module-id=0xAB, provided-entrys=[Pfm_Init, Pfm_10ms, Pfm_EnableDiagnostic, Pfm_DefectReport, Pfm_ClearFault, Pfm_ClearFaultAll, Pfm_GetFaultState]
    bsw internal behavior BswIbh_Pfm
      exclusive area Pfm_Exclusive_Area
      event-controlled-timing-events:
        event controlled timing Pfm_10ms_EventTiming: controlled-timing-event=Pfm_10ms
  7 x bsw module entry:
    Pfm_Init: calls=bsw-module-call-point={call-type=RETURNING, operation-invoked=Dem_Init}, service-id=0x01
    Pfm_10ms: calls=bsw-module-call-point={call-type=RETURNING, operation-invoked=Dem_SetEventStatus}, service-id=0x02
      timing event Pfm_10ms_TimingEvent: event-controlled-timing-event=event-period=0.010
    Pfm_EnableDiagnostic: service-id=0x03
    Pfm_DefectReport: service-id=0x04
    Pfm_ClearFault: service-id=0x05
    Pfm_ClearFaultAll: service-id=0x06
    Pfm_GetFaultState: service-id=0x07
